/*
 * Piantor Pro BT (6-column, 42 keys) — Gallium + Seniply
 *
 * 这个文件只负责板级的东西（选物理布局、引头文件）。
 * 所有键位在 gallium_seniply.dtsi 里，将来 dongle 版直接 include 同一个文件。
 */

#include <behaviors.dtsi>
#include <dt-bindings/zmk/keys.h>
#include <dt-bindings/zmk/bt.h>
#include <dt-bindings/zmk/outputs.h>
#include <dt-bindings/zmk/ext_power.h>

/ {
    chosen {
        zmk,physical-layout = &default_layout;
    };
};

#include "gallium_seniply.dtsi"
