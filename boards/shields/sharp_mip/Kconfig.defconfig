## boards/shields/sharp_mip/Kconfig.defconfig
```kconfig
# Copyright (c) 2023 The ZMK Contributors
# SPDX-License-Identifier: MIT

if SHIELD_SHARP_MIP

config LV_Z_VDB_SIZE
    default 100

config LV_DPI_DEF
    default 161

config LV_Z_BITS_PER_PIXEL
    default 1

choice LV_COLOR_DEPTH
    default LV_COLOR_DEPTH_1
endchoice

choice ZMK_DISPLAY_WORK_QUEUE
    default ZMK_DISPLAY_WORK_QUEUE_DEDICATED
endchoice

config ZMK_DISPLAY_DEDICATED_THREAD_STACK_SIZE
    default 4096 if KEEBART_STUDIO

choice ZMK_DISPLAY_STATUS_SCREEN
    default ZMK_DISPLAY_STATUS_SCREEN_CUSTOM
endchoice

config LV_Z_MEM_POOL_SIZE
    default 4096 if ZMK_DISPLAY_STATUS_SCREEN_CUSTOM

config ZMK_DISPLAY_STATUS_SCREEN_CUSTOM
    imply SHARP_MIP_WIDGET_STATUS

config SHARP_MIP_WIDGET_STATUS
    bool "Custom Sharp MIP status widget"
    select LV_FONT_MONTSERRAT_16
    select LV_USE_IMG
    select LV_USE_CANVAS

config SHARP_MIP_WIDGET_INVERTED
    bool "Invert Sharp MIP status widget colors"

config SHARP_MIP_ROTATE_180
    bool "Rotate Sharp MIP display 180 degrees"
    default y if BOARD_SOFLE_CHOC_PRO_LEFT || BOARD_SOFLE_CHOC_PRO_RIGHT

if !ZMK_SPLIT || ZMK_SPLIT_ROLE_CENTRAL

config SHARP_MIP_WIDGET_STATUS
    select LV_FONT_MONTSERRAT_18
    select LV_FONT_MONTSERRAT_14
    select LV_FONT_MONTSERRAT_12 if KEEBART_STUDIO
    select LV_FONT_UNSCII_8
    select ZMK_WPM

endif # !ZMK_SPLIT || ZMK_SPLIT_ROLE_CENTRAL

config ZMK_DISPLAY_STATUS_SCREEN_BUILT_IN
    select LV_FONT_MONTSERRAT_26

endif # SHIELD_SHARP_MIP
```

## studio/Kconfig
```kconfig
config KEEBART_STUDIO
    bool "Keebart Studio USB configuration"
    depends on ZMK_USB && (!ZMK_SPLIT || ZMK_SPLIT_ROLE_CENTRAL)
    depends on !ZMK_STUDIO
    select SETTINGS
    select USB_DEVICE_HID
    select ZMK_USB_BOOT

config KEEBART_STUDIO_PERIPHERAL
    bool "Keebart Studio split lighting receiver"
    depends on ZMK_SPLIT && !ZMK_SPLIT_ROLE_CENTRAL
```
