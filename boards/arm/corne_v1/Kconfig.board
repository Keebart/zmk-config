## boards/arm/corne_v1/Kconfig.board
```kconfig
# Copyright (c) 2020 The ZMK Contributors
# SPDX-License-Identifier: MIT

config BOARD_CORNE_V1_LEFT
	bool "Corne V1 Left"
	depends on SOC_NRF52840_QIAA

config BOARD_CORNE_V1_RIGHT
    bool "Corne V1 Right"
    depends on SOC_NRF52840_QIAA
```

## boards/arm/corne_v2/Kconfig
```kconfig
# SPDX-License-Identifier: MIT

config BOARD_ENABLE_DCDC
	bool "Enable DCDC mode"
	select SOC_DCDC_NRF52X
	default y
	depends on (BOARD_CORNE_V2_LEFT || BOARD_CORNE_V2_RIGHT)
```

## boards/arm/corne_v2/Kconfig.board
```kconfig
# Copyright (c) 2020 The ZMK Contributors
# SPDX-License-Identifier: MIT

config BOARD_CORNE_V2_LEFT
	bool "Corne V2 Left"
	depends on SOC_NRF52840_QIAA

config BOARD_CORNE_V2_RIGHT
	bool "Corne V2 Right"
	depends on SOC_NRF52840_QIAA
```

## boards/arm/corne_v2/Kconfig.defconfig
```kconfig
# Copyright (c) 2020 The ZMK Contributors
# SPDX-License-Identifier: MIT

if BOARD_CORNE_V2_RIGHT

config ZMK_KEYBOARD_NAME
	default "Corne NumNav"

config ZMK_SPLIT_ROLE_CENTRAL
    default y

endif # BOARD_CORNE_V2_RIGHT

if BOARD_CORNE_V2_LEFT || BOARD_CORNE_V2_RIGHT

config BOARD
    default "corne_v2"

config ZMK_SPLIT
    default y

if USB

config USB_NRFX
	default y

config USB_DEVICE_STACK
	default y

endif # USB

config BT_CTLR
	default BT

config I2C
	default y

config ZMK_MAX17048
    default y

endif # BOARD_CORNE_V2_LEFT || BOARD_CORNE_V2_RIGHT
```

## boards/arm/corne_v3/Kconfig.board
```kconfig
# Copyright (c) 2020 The ZMK Contributors
# SPDX-License-Identifier: MIT

config BOARD_CORNE_V3_LEFT
	bool "Corne V3 Left"
	depends on SOC_NRF52840_QIAA

config BOARD_CORNE_V3_RIGHT
	bool "Corne V3 Right"
	depends on SOC_NRF52840_QIAA
```
